## CMakeLists.txt
```
cmake_minimum_required(VERSION 3.20.0)

find_package(Zephyr REQUIRED HINTS $ENV{ZEPHYR_BASE})
project({{PROJECT_NAME}})

# Source files
target_sources(app PRIVATE
    src/main.c
)

# Uncomment to add include directories
# target_include_directories(app PRIVATE include)

# Uncomment to link with common library
# target_link_libraries(app PRIVATE zephyr_common)
```

## prj.conf
```kconfig
# {{PROJECT_DISPLAY_NAME}} Configuration

# Serial console (for debugging)
CONFIG_SERIAL=y
CONFIG_CONSOLE=y
CONFIG_UART_CONSOLE=y

# Logging
CONFIG_LOG=y
CONFIG_LOG_DEFAULT_LEVEL=3  # 0=OFF, 1=ERROR, 2=WARNING, 3=INFO, 4=DEBUG

# Stack size
CONFIG_MAIN_STACK_SIZE=2048

# Heap size (for malloc, uncomment if needed)
# CONFIG_HEAP_MEM_POOL_SIZE=2048

# GPIO
CONFIG_GPIO=y
```

## src/main.c
```c
/**
 * @file main.c
 * @brief {{PROJECT_DISPLAY_NAME}} - Blinky Example
 * @author Generated by zephyr-meta
 */

#include <zephyr/kernel.h>
#include <zephyr/drivers/gpio.h>
#include <zephyr/logging/log.h>

LOG_MODULE_REGISTER(main, LOG_LEVEL_INF);

/* LED0 device tree alias */
#define LED0_NODE DT_ALIAS(led0)
static const struct gpio_dt_spec led = GPIO_DT_SPEC_GET(LED0_NODE, gpios);

int main(void)
{
	LOG_INF("Starting {{PROJECT_DISPLAY_NAME}}...");
	LOG_INF("Board: {{BOARD_NAME}}");

	/* Check if LED device is ready */
	if (!gpio_is_ready_dt(&led)) {
		LOG_ERR("LED device not ready");
		return -1;
	}

	/* Configure LED pin as output */
	int ret = gpio_pin_configure_dt(&led, GPIO_OUTPUT_ACTIVE);
	if (ret < 0) {
		LOG_ERR("Failed to configure LED pin: %d", ret);
		return ret;
	}

	LOG_INF("LED initialized successfully");

	/* Main loop: Blink LED */
	while (1) {
		gpio_pin_toggle_dt(&led);
		k_msleep(1000);
	}

	return 0;
}
```
